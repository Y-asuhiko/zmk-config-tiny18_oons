#include "tiny18.dtsi"
#include <input/processors.dtsi>

/ {
    chosen {
        zmk,kscan-transform = &default_transform;
    };
};

&default_transform {
    col-offset = <0>;
};

&xiao_serial {
    status = "disabled";
};
